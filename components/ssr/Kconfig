## components/ssr/Kconfig
```kconfig
menu "SSR"
config SSR_GPIO
    int "GPIO connected to SSR"
    default 4

config SSR_DEBOUNCE_ON
    int "SSR Hysteresis debounce ON"
    default 2

config SSR_DEBOUNCE_OFF
    int "SSR Hysteresis debounce OFF"
    default 4

config SSR_WATCHDOG_S
    int "SSR Watchdog (s)"
    default 180
endmenu

menu "Power"
config P_BOILER_MAX_NOM
    int "Nominal maximum power of boiler (W)"
    default 3400
endmenu
```

## components/wifi/Kconfig
```kconfig
menu "WiFi"
config WIFI_SSID
    string "WiFi SSID"
    default "MyIoTWiFi"

config WIFI_PASSWORD
    string "WiFi Password"
    default "MyIoTWiFiPassword"

config WIFI_MAX_STACK_RESTARTS
    int "WiFi Stack Max Restarts before Fatal"
    default 3
endmenu
```

## main/Kconfig.projbuild
```kconfig
# Kconfig.projbuild im Projekt-Root
menu "Custom"
    osource "../components/ssr/Kconfig"
    osource "../components/http/Kconfig"
    osource "../components/wifi/Kconfig"
endmenu
```
