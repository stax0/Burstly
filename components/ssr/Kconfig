## components/ssr/Kconfig
```kconfig
menu "SSR"
config SSR_GPIO
    int "GPIO connected to SSR"
    default 4

config SSR_UPSHIFT_DEBOUNCE
    int "SSR Hysteresis Upshift Debounce"
    default 2

config SSR_WATCHDOG_S
    int "SSR Watchdog (s)"
    default 180
endmenu

menu "Power"
config P_BOILER_MAX_NOM
    int "Nominal maximum power of boiler (W)"
    default 3400
endmenu
```

## components/status_led/Kconfig
```kconfig
menu "Status LED"
config STATUS_LED_GPIO
    int "GPIO of the WS2812 status LED"
    default 38
endmenu
```
